// Authors: rom1, iTitou, Infected, Minorias

#define COL_PIXEL     64
#define ROW_PIXEL     16

int latchPin=8; //LT
int clockPin=12;//SK
int dataPin=11; //R1

int en_74138 = 2;
int la_74138 = 3;
int lb_74138 = 4;
int lc_74138 = 5;
int ld_74138 = 6;

unsigned int ROW_xPixel = 15;
unsigned int ROW_num;
unsigned char Col_num_1;
unsigned char Col_num_2;
unsigned char Col_num_3;
unsigned char Col_num_4;
unsigned char Col_num_5;
unsigned char Col_num_6;
unsigned char Col_num_7;
unsigned char Col_num_8;

//Data code: Horizontal modulus ,Bytes reverse order
unsigned char  Bmp1[]=
{
0xff, 0xff, 0xff, 0xff, 0xff, 0xff, 0xff, 0xff,
0x9e, 0x40, 0x27, 0xf7, 0xf8, 0x6, 0x7f, 0xcf,
0x9e, 0x40, 0x27, 0xf3, 0xf8, 0xe, 0x3f, 0x8f,
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0xff, 0xff, 0xff, 0xff, 0xff, 0xff, 0x9f, 0x3f
};

unsigned char Bmp2[]=
{
0x0, 0x0, 0x0, 0x0, 0x0, 0x0, 0x0, 0x0,
0x61, 0xbf, 0xd8, 0x8, 0x7, 0xf9, 0x80, 0x30,
0x61, 0xbf, 0xd8, 0xc, 0x7, 0xf1, 0xc0, 0x70,
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0x0, 0x0, 0x0, 0x0, 0x0, 0x0, 0x60, 0xc0
};

void shiftOut(unsigned char dataOut)
{
    for(int i=7;i>=0;i--)
    {
        PORTB &=~(1<<(clockPin-8));//equate digitalWrite(clockPin,LOW);

        if(dataOut & (0x01<<i))  PORTB |=1<<(dataPin-8); //equate digitalWrite(dataPin,HIGH);
        else  PORTB &=~(1<<(dataPin-8));//equate digitalWrite(dataPin,LOW);

        PORTB |=1<<(clockPin-8);//equate digitalWrite(clockPin,HIGH);
    }
}

//display one picture 
void display_martix(unsigned char *BMP)
{
    //Display count
    //unsigned int dis_cnt=1;
    unsigned int i;
    for(i=0;i<16;i++)
    {
        if(ROW_xPixel==15) ROW_xPixel=0; else ROW_xPixel++;
        
        // Single color,1 bits/pixel
        Col_num_1=~BMP[(COL_PIXEL/8)*ROW_xPixel];
        Col_num_2=~BMP[(COL_PIXEL/8)*ROW_xPixel+1];
        Col_num_3=~BMP[(COL_PIXEL/8)*ROW_xPixel+2];
        Col_num_4=~BMP[(COL_PIXEL/8)*ROW_xPixel+3];
        Col_num_5=~BMP[(COL_PIXEL/8)*ROW_xPixel+4];
        Col_num_6=~BMP[(COL_PIXEL/8)*ROW_xPixel+5];
        Col_num_7=~BMP[(COL_PIXEL/8)*ROW_xPixel+6];
        Col_num_8=~BMP[(COL_PIXEL/8)*ROW_xPixel+7];
        
        
        //digitalWrite(en_74138, HIGH);//Turn off display

        //Col scanning
        shiftOut(Col_num_1);
        shiftOut(Col_num_2);
        shiftOut(Col_num_3);
        shiftOut(Col_num_4);
        shiftOut(Col_num_5);
        shiftOut(Col_num_6);
        shiftOut(Col_num_7);
        shiftOut(Col_num_8);

        digitalWrite(latchPin, LOW);
        digitalWrite(latchPin, HIGH);

        //Row scanning
        // AVR Port Operation 
        PORTD = ((ROW_xPixel << 3 ) & 0X78) | (PORTD & 0X87);//Write PIN 3 4 5 6 la_74138 lb_74138 lc_74138 ld_74138

        //digitalWrite(en_74138, LOW);//Turn on display

        //delayMicroseconds(10000);1        
    }
}

void shift_matrix(unsigned char *BMP){
    for(int i=0; i<128; i++)
        BMP[i] = BMP[i]<< 1 | BMP[i]>>(7);
}

unsigned char *write_data = Bmp1;
unsigned char *read_data = Bmp2;

int head = 0;
unsigned char incomingByte = 0x00;

void serial_input()
{
      while (Serial.available() > 0)
      {
        incomingByte = Serial.read();
        write_data[head] = incomingByte;
        
        if (head >= 127)
        {
          head = 0;
          unsigned char *tmp = read_data;
          read_data = write_data;
          write_data = tmp;
        }
        else
        {
          head++;
        }
      }
}


void setup()
{
    pinMode(latchPin,OUTPUT);
    pinMode(clockPin,OUTPUT);
    pinMode(dataPin,OUTPUT);

    pinMode(en_74138,OUTPUT);
    pinMode(la_74138,OUTPUT);
    pinMode(lb_74138,OUTPUT);
    pinMode(lc_74138,OUTPUT);
    pinMode(ld_74138,OUTPUT);

    digitalWrite(en_74138, LOW);

    // AVR Port Settings
    DDRD |= 0x78; //Set PIN 3 4 5 6 output
    
    Serial.begin(19200);
}


void loop()
{
    serial_input();
    display_martix(read_data);
    //shift_matrix(read_data);
}
